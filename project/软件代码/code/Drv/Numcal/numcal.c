#include "numcal.h"
/* ==================================================================
#     	名	  称 ：温度对照表									    #
#     	适用范围 ：-20℃ to 120℃ 									#
#     	修改时间 ：2018-9-24										#
================================================================== */
double resistor_to_temperature_tbl[] = {
	98.26 , 92.74 , 87.55 , 82.69 , 78.12 , 73.83 , 69.8 , 66.01 , 62.45 ,
	59.1  , 55.95 , 52.98 , 50.19 , 47.57 , 45.09 , 42.76 , 40.56 , 38.49 ,
	36.53 , 34.68 , 32.94 , 31.3  , 29.74 , 28.28 , 26.89 , 25.58 , 24.34 ,
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	0.4386,	0.4268,	0.4155,	0.4045,	0.3939,	0.3835,
};

/* ==================================================================
#     函数介绍: 输入温度模块AD值，计算温度						    #
#     参    数:	ADC_data 温度模块AD值								#
#     返 回 值: int : 温度值（摄氏度s）							#
#     作    者: 许     兵											#
#     修改时间: 2018-9-24											#
================================================================== */
int conv_res_to_temp(unsigned short ADC_data)
{
	double voltage_val_mV = ((double)ADC_data*3300.0)/4095.0;
	double resistor_val = (10000.0 * voltage_val_mV) / (3300.0 - voltage_val_mV);	// R7/(R1+R7)*3.3 = V	
	double resistor_val_max;
	double resistor_val_min;
	int i;
	int tbl_len = sizeof(resistor_to_temperature_tbl)/sizeof(double);
	
	resistor_val_min = resistor_to_temperature_tbl[tbl_len - 1] * 1000.0;
	resistor_val_max = resistor_to_temperature_tbl[0] * 1000.0;

	if(resistor_val < 0 || resistor_val > resistor_val_max ||  resistor_val < resistor_val_min)
		return -1;

	for(i = 0; i < tbl_len; i++){
		//printf("resistor_val:%f, tbl:%f\n", resistor_val, resistor_to_temperature_tbl[i]* 10000.0);
		if(resistor_val >= resistor_to_temperature_tbl[i] * 1000.0)
			break;
	}
	//printf("index:%d\n", i);

	return i-20;
}
